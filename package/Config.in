## package/Config.in
```kconfig
menu "curiOS"
	source "$BR2_EXTERNAL_CURIOS_PATH/package/curios-health/Config.in"
endmenu

menu "Networking applications"
	source "$BR2_EXTERNAL_CURIOS_PATH/package/mcjoin/Config.in"
	source "$BR2_EXTERNAL_CURIOS_PATH/package/mping/Config.in"
	source "$BR2_EXTERNAL_CURIOS_PATH/package/nft-helper/Config.in"
endmenu
```

## package/curios-health/Config.in
```kconfig
config BR2_PACKAGE_CURIOS_HEALTH
	bool "curios-health"
	help
	  Container health probe.  Reports whether a service holds the
	  socket it is supposed to hold, by reading /proc directly, so
	  it works in images that have no shell.

	  Installed as /usr/libexec/curios/curios-health.
```
