## board/neofetch/busybox_defconfig
```kconfig
#
# Minimal BusyBox configuration for neofetch
# Only includes essential applets needed for neofetch to function
#
CONFIG_HAVE_DOT_CONFIG=y

#
# Settings
#
CONFIG_LONG_OPTS=y
CONFIG_BUSYBOX=y
CONFIG_FEATURE_INSTALLER=y
CONFIG_STATIC=y

#
# Shell - Required for neofetch script execution
#
CONFIG_ASH=y
CONFIG_ASH_OPTIMIZE_FOR_SIZE=y
CONFIG_SH_IS_ASH=y
CONFIG_BASH_IS_NONE=y

#
# Essential utilities for neofetch system information gathering
#
CONFIG_UNAME=y       # Kernel/system info
CONFIG_CAT=y         # Read files from /proc, /sys
CONFIG_GREP=y        # Pattern matching
CONFIG_CUT=y         # Field extraction
CONFIG_AWK=y         # Text processing
CONFIG_SED=y         # Text processing  
CONFIG_HEAD=y        # File content
CONFIG_TR=y          # Character translation
CONFIG_PRINTF=y      # Output formatting
CONFIG_PS=y          # Process information
CONFIG_READLINK=y    # Link resolution
CONFIG_BASENAME=y    # Path manipulation
CONFIG_DIRNAME=y     # Path manipulation

#
# Disable all non-essential applets
#
# CONFIG_DESKTOP is not set
# CONFIG_EXTRA_COMPAT is not set
# CONFIG_INCLUDE_SUSv2 is not set
# CONFIG_SHOW_USAGE is not set
# CONFIG_FEATURE_VERBOSE_USAGE is not set
# CONFIG_LFS is not set
# CONFIG_PAM is not set
```

## configs/curios-nftables_arm64_defconfig
```kconfig
BR2_aarch64=y
BR2_TOOLCHAIN_EXTERNAL=y
BR2_TOOLCHAIN_EXTERNAL_BOOTLIN=y
BR2_TOOLCHAIN_EXTERNAL_BOOTLIN_AARCH64_UCLIBC_STABLE=y
BR2_DL_DIR="${BR2_EXTERNAL_CURIOS_PATH}/dl"
BR2_CCACHE=y
BR2_CCACHE_DIR="${BR2_EXTERNAL_CURIOS_PATH}/.ccache"
BR2_TARGET_GENERIC_HOSTNAME="curiOS"
BR2_TARGET_GENERIC_ISSUE="Welcome to curiOS"
BR2_TARGET_GENERIC_ROOT_PASSWD="secret"
BR2_ROOTFS_OVERLAY="$(BR2_EXTERNAL_CURIOS_PATH)/board/common/rootfs"
BR2_ROOTFS_POST_BUILD_SCRIPT="$(BR2_EXTERNAL_CURIOS_PATH)/board/common/post-build.sh"
BR2_PACKAGE_BUSYBOX_SHOW_OTHERS=y
# BR2_PACKAGE_IFUPDOWN_SCRIPTS is not set
BR2_PACKAGE_MG=y
BR2_PACKAGE_NFTABLES=y
# BR2_PACKAGE_URANDOM_SCRIPTS is not set
BR2_TARGET_ROOTFS_OCI=y
BR2_TARGET_ROOTFS_OCI_AUTHOR="curiOS"
BR2_TARGET_ROOTFS_OCI_TAG="edge"
BR2_TARGET_ROOTFS_OCI_ENTRYPOINT="/sbin/init"
BR2_TARGET_ROOTFS_OCI_LABELS=".url=https://github.com/kernelkit/curiOS .title=curiOS-ntpd"
```

## configs/curios-ntpd_arm64_defconfig
```kconfig
BR2_aarch64=y
BR2_TOOLCHAIN_EXTERNAL=y
BR2_TOOLCHAIN_EXTERNAL_BOOTLIN=y
BR2_TOOLCHAIN_EXTERNAL_BOOTLIN_AARCH64_UCLIBC_STABLE=y
BR2_DL_DIR="${BR2_EXTERNAL_CURIOS_PATH}/dl"
BR2_CCACHE=y
BR2_CCACHE_DIR="${BR2_EXTERNAL_CURIOS_PATH}/.ccache"
BR2_TARGET_GENERIC_HOSTNAME="curiOS"
BR2_TARGET_GENERIC_ISSUE="Welcome to curiOS"
BR2_TARGET_GENERIC_ROOT_PASSWD="secret"
BR2_ROOTFS_OVERLAY="$(BR2_EXTERNAL_CURIOS_PATH)/board/common/rootfs"
BR2_ROOTFS_POST_BUILD_SCRIPT="$(BR2_EXTERNAL_CURIOS_PATH)/board/common/post-build.sh"
BR2_PACKAGE_BUSYBOX_SHOW_OTHERS=y
# BR2_PACKAGE_IFUPDOWN_SCRIPTS is not set
BR2_PACKAGE_MG=y
BR2_PACKAGE_NTP=y
BR2_PACKAGE_NTP_SNTP=y
BR2_PACKAGE_NTP_NTP_KEYGEN=y
BR2_PACKAGE_NTP_NTPD_ATOM_PPS=y
BR2_PACKAGE_NTP_NTPDC=y
BR2_PACKAGE_NTP_NTPQ=y
BR2_PACKAGE_NTP_NTPTIME=y
BR2_PACKAGE_NTP_TICKADJ=y
# BR2_PACKAGE_URANDOM_SCRIPTS is not set
BR2_TARGET_ROOTFS_OCI=y
BR2_TARGET_ROOTFS_OCI_AUTHOR="curiOS"
BR2_TARGET_ROOTFS_OCI_TAG="edge"
BR2_TARGET_ROOTFS_OCI_ENTRYPOINT="/sbin/init"
BR2_TARGET_ROOTFS_OCI_PORTS="123/udp"
BR2_TARGET_ROOTFS_OCI_LABELS=".url=https://github.com/kernelkit/curiOS .title=curiOS-ntpd"
```

## configs/curios_amd64_defconfig
```kconfig
BR2_x86_64=y
BR2_TOOLCHAIN_EXTERNAL=y
BR2_TOOLCHAIN_EXTERNAL_BOOTLIN_X86_64_UCLIBC_STABLE=y
BR2_DL_DIR="${BR2_EXTERNAL_CURIOS_PATH}/dl"
BR2_CCACHE=y
BR2_CCACHE_DIR="${BR2_EXTERNAL_CURIOS_PATH}/.ccache"
BR2_TARGET_GENERIC_HOSTNAME="curiOS"
BR2_TARGET_GENERIC_ISSUE="Welcome to curiOS"
BR2_TARGET_GENERIC_ROOT_PASSWD="secret"
BR2_ROOTFS_OVERLAY="$(BR2_EXTERNAL_CURIOS_PATH)/board/common/rootfs $(BR2_EXTERNAL_CURIOS_PATH)/board/system/rootfs"
BR2_ROOTFS_POST_BUILD_SCRIPT="$(BR2_EXTERNAL_CURIOS_PATH)/board/common/post-build.sh"
BR2_PACKAGE_BUSYBOX_SHOW_OTHERS=y
BR2_PACKAGE_NETOPEER2=y
BR2_PACKAGE_NETOPEER2_CLI=y
BR2_PACKAGE_DROPBEAR=y
BR2_PACKAGE_DROPBEAR_DISABLE_REVERSEDNS=y
BR2_PACKAGE_MINI_SNMPD=y
BR2_PACKAGE_MG=y
BR2_TARGET_ROOTFS_OCI=y
BR2_TARGET_ROOTFS_OCI_AUTHOR="curiOS"
BR2_TARGET_ROOTFS_OCI_TAG="edge"
BR2_TARGET_ROOTFS_OCI_ENTRYPOINT="/sbin/init"
BR2_TARGET_ROOTFS_OCI_PORTS="22/tcp 161/tcp 161/udp"
BR2_TARGET_ROOTFS_OCI_LABELS=".url=https://github.com/kernelkit/curiOS .title=curiOS"
```

## configs/curios_arm64_defconfig
```kconfig
BR2_aarch64=y
BR2_TOOLCHAIN_EXTERNAL=y
BR2_TOOLCHAIN_EXTERNAL_BOOTLIN=y
BR2_TOOLCHAIN_EXTERNAL_BOOTLIN_AARCH64_UCLIBC_STABLE=y
BR2_DL_DIR="${BR2_EXTERNAL_CURIOS_PATH}/dl"
BR2_CCACHE=y
BR2_CCACHE_DIR="${BR2_EXTERNAL_CURIOS_PATH}/.ccache"
BR2_TARGET_GENERIC_HOSTNAME="curiOS"
BR2_TARGET_GENERIC_ISSUE="Welcome to curiOS"
BR2_PACKAGE_NETOPEER2=y
BR2_PACKAGE_NETOPEER2_CLI=y
BR2_PACKAGE_DROPBEAR=y
BR2_PACKAGE_DROPBEAR_DISABLE_REVERSEDNS=y
BR2_PACKAGE_MINI_SNMPD=y
BR2_TARGET_ROOTFS_OCI=y
BR2_TARGET_ROOTFS_OCI_AUTHOR="curiOS"
BR2_TARGET_ROOTFS_OCI_TAG="edge"
BR2_TARGET_ROOTFS_OCI_PORTS="22/tcp 161/tcp 161/udp"
BR2_TARGET_ROOTFS_OCI_LABELS=".url=https://github.com/kernelkit/curiOS .title=curiOS"
```

## configs/curios_defconfig
```kconfig
BR2_x86_64=y
BR2_TOOLCHAIN_EXTERNAL=y
BR2_TOOLCHAIN_EXTERNAL_BOOTLIN_X86_64_UCLIBC_STABLE=y
BR2_TARGET_GENERIC_HOSTNAME="curiOS"
BR2_TARGET_GENERIC_ISSUE="Welcome to curiOS"
BR2_PACKAGE_NETOPEER2=y
BR2_PACKAGE_NETOPEER2_CLI=y
BR2_PACKAGE_DROPBEAR=y
BR2_PACKAGE_DROPBEAR_DISABLE_REVERSEDNS=y
BR2_PACKAGE_MINI_SNMPD=y
BR2_TARGET_ROOTFS_OCI=y
BR2_TARGET_ROOTFS_OCI_AUTHOR="curiOS"
BR2_PACKAGE_HOST_MKPASSWD=y
```

## configs/httpd_amd64_defconfig
```kconfig
BR2_x86_64=y
BR2_TOOLCHAIN_EXTERNAL=y
BR2_TOOLCHAIN_EXTERNAL_BOOTLIN_X86_64_UCLIBC_STABLE=y
BR2_DL_DIR="${BR2_EXTERNAL_CURIOS_PATH}/dl"
BR2_CCACHE=y
BR2_CCACHE_DIR="${BR2_EXTERNAL_CURIOS_PATH}/.ccache"
BR2_STATIC_LIBS=y
BR2_TARGET_GENERIC_HOSTNAME="curiOS"
BR2_TARGET_GENERIC_ISSUE="Welcome to curiOS"
BR2_INIT_NONE=y
# BR2_TARGET_GENERIC_GETTY is not set
# BR2_TARGET_GENERIC_REMOUNT_ROOTFS_RW is not set
BR2_ROOTFS_OVERLAY="$(BR2_EXTERNAL_CURIOS_PATH)/board/httpd/rootfs"
BR2_ROOTFS_POST_BUILD_SCRIPT="$(BR2_EXTERNAL_CURIOS_PATH)/board/common/post-build.sh"
BR2_ROOTFS_POST_IMAGE_SCRIPT="$(BR2_EXTERNAL_CURIOS_PATH)/board/common/post-image.sh"
BR2_PACKAGE_BUSYBOX_CONFIG="${BR2_EXTERNAL_CURIOS_PATH}/board/httpd/busybox_defconfig"
# BR2_PACKAGE_IFUPDOWN_SCRIPTS is not set
BR2_PACKAGE_TINI=y
BR2_TARGET_ROOTFS_OCI=y
BR2_TARGET_ROOTFS_OCI_AUTHOR="curiOS"
BR2_TARGET_ROOTFS_OCI_TAG="curios-httpd"
BR2_TARGET_ROOTFS_OCI_ENTRYPOINT="/usr/bin/tini --"
BR2_TARGET_ROOTFS_OCI_CMD="/usr/sbin/httpd -f -v"
BR2_TARGET_ROOTFS_OCI_WORKDIR="/var/www"
BR2_TARGET_ROOTFS_OCI_PORTS="80/tcp"
BR2_TARGET_ROOTFS_OCI_LABELS=".url=https://github.com/kernelkit/curiOS .title=curiOS-httpd .description=Ultra-lightweight⠀BusyBox⠀web⠀server⠀for⠀embedded⠀applications⠀and⠀IoT⠀devices."
# BR2_TARGET_ROOTFS_TAR is not set
```

## configs/neofetch_amd64_defconfig
```kconfig
BR2_x86_64=y
BR2_TOOLCHAIN_EXTERNAL=y
BR2_TOOLCHAIN_EXTERNAL_BOOTLIN_X86_64_UCLIBC_STABLE=y
BR2_DL_DIR="${BR2_EXTERNAL_CURIOS_PATH}/dl"
BR2_CCACHE=y
BR2_CCACHE_DIR="${BR2_EXTERNAL_CURIOS_PATH}/.ccache"
BR2_STATIC_LIBS=y
BR2_TARGET_GENERIC_HOSTNAME="curiOS"
BR2_TARGET_GENERIC_ISSUE="Welcome to curiOS"
BR2_INIT_NONE=y
# BR2_TARGET_GENERIC_GETTY is not set
# BR2_TARGET_GENERIC_REMOUNT_ROOTFS_RW is not set
BR2_ROOTFS_POST_BUILD_SCRIPT="$(BR2_EXTERNAL_CURIOS_PATH)/board/common/post-build.sh"
BR2_PACKAGE_BUSYBOX_CONFIG="${BR2_EXTERNAL_CURIOS_PATH}/board/neofetch/busybox_defconfig"
BR2_PACKAGE_BUSYBOX_SHOW_OTHERS=y
# BR2_PACKAGE_IFUPDOWN_SCRIPTS is not set
BR2_PACKAGE_NEOFETCH=y
BR2_TARGET_ROOTFS_OCI=y
BR2_TARGET_ROOTFS_OCI_AUTHOR="curiOS"
BR2_TARGET_ROOTFS_OCI_TAG="edge"
BR2_TARGET_ROOTFS_OCI_ENTRYPOINT="/usr/bin/neofetch"
BR2_TARGET_ROOTFS_OCI_LABELS=".url=https://github.com/kernelkit/curiOS .title=curiOS-neofetch"
```

## configs/nftables_arm64_defconfig
```kconfig
BR2_aarch64=y
BR2_TOOLCHAIN_EXTERNAL=y
BR2_TOOLCHAIN_EXTERNAL_BOOTLIN=y
BR2_TOOLCHAIN_EXTERNAL_BOOTLIN_AARCH64_UCLIBC_STABLE=y
BR2_DL_DIR="${BR2_EXTERNAL_CURIOS_PATH}/dl"
BR2_CCACHE=y
BR2_CCACHE_DIR="${BR2_EXTERNAL_CURIOS_PATH}/.ccache"
BR2_OPTIMIZE_S=y
BR2_STATIC_LIBS=y
BR2_GLOBAL_PATCH_DIR="${BR2_EXTERNAL_CURIOS_PATH}/patches"
BR2_TARGET_GENERIC_HOSTNAME="curiOS"
BR2_TARGET_GENERIC_ISSUE="Welcome to curiOS"
# BR2_TARGET_ENABLE_ROOT_LOGIN is not set
# BR2_TARGET_GENERIC_GETTY is not set
# BR2_TARGET_GENERIC_REMOUNT_ROOTFS_RW is not set
BR2_ROOTFS_OVERLAY="$(BR2_EXTERNAL_CURIOS_PATH)/board/common/rootfs $(BR2_EXTERNAL_CURIOS_PATH)/board/nftables/rootfs"
BR2_ROOTFS_POST_BUILD_SCRIPT="$(BR2_EXTERNAL_CURIOS_PATH)/board/common/post-build.sh"
BR2_ROOTFS_POST_IMAGE_SCRIPT="$(BR2_EXTERNAL_CURIOS_PATH)/board/common/post-image.sh"
BR2_PACKAGE_BUSYBOX_CONFIG="${BR2_EXTERNAL_CURIOS_PATH}/board/nftables/busybox_defconfig"
# BR2_PACKAGE_IFUPDOWN_SCRIPTS is not set
BR2_PACKAGE_NFTABLES=y
# BR2_PACKAGE_URANDOM_SCRIPTS is not set
BR2_TARGET_ROOTFS_OCI=y
BR2_TARGET_ROOTFS_OCI_AUTHOR="curiOS"
BR2_TARGET_ROOTFS_OCI_TAG="edge"
BR2_TARGET_ROOTFS_OCI_ENTRYPOINT="/sbin/init"
BR2_TARGET_ROOTFS_OCI_LABELS=".url=https://github.com/kernelkit/curiOS .title=curiOS-nftables"
# BR2_TARGET_ROOTFS_TAR is not set
```

## configs/ntpd_amd64_defconfig
```kconfig
BR2_x86_64=y
BR2_TOOLCHAIN_EXTERNAL=y
BR2_TOOLCHAIN_EXTERNAL_BOOTLIN_X86_64_UCLIBC_STABLE=y
BR2_DL_DIR="${BR2_EXTERNAL_CURIOS_PATH}/dl"
BR2_CCACHE=y
BR2_CCACHE_DIR="${BR2_EXTERNAL_CURIOS_PATH}/.ccache"
BR2_STATIC_LIBS=y
BR2_TARGET_GENERIC_HOSTNAME="curiOS"
BR2_TARGET_GENERIC_ISSUE="Welcome to curiOS"
BR2_INIT_NONE=y
# BR2_TARGET_ENABLE_ROOT_LOGIN is not set
BR2_SYSTEM_BIN_SH_NONE=y
# BR2_TARGET_GENERIC_GETTY is not set
# BR2_TARGET_GENERIC_REMOUNT_ROOTFS_RW is not set
BR2_ROOTFS_POST_BUILD_SCRIPT="$(BR2_EXTERNAL_CURIOS_PATH)/board/common/post-build.sh"
BR2_ROOTFS_POST_IMAGE_SCRIPT="$(BR2_EXTERNAL_CURIOS_PATH)/board/common/post-image.sh"
# BR2_PACKAGE_BUSYBOX is not set
# BR2_PACKAGE_IFUPDOWN_SCRIPTS is not set
BR2_PACKAGE_NTP=y
BR2_PACKAGE_NTP_NTPDC=y
BR2_PACKAGE_NTP_NTPQ=y
BR2_PACKAGE_TINI=y
BR2_TARGET_ROOTFS_OCI=y
BR2_TARGET_ROOTFS_OCI_AUTHOR="curiOS"
BR2_TARGET_ROOTFS_OCI_TAG="curios-ntpd"
BR2_TARGET_ROOTFS_OCI_ENTRYPOINT="/usr/bin/tini --"
BR2_TARGET_ROOTFS_OCI_CMD="/usr/sbin/ntpd -n -g"
BR2_TARGET_ROOTFS_OCI_PORTS="123/udp"
BR2_TARGET_ROOTFS_OCI_LABELS=".url=https://github.com/kernelkit/curiOS .title=curiOS-ntpd"
# BR2_TARGET_ROOTFS_TAR is not set
```

## configs/system_amd64_defconfig
```kconfig
BR2_x86_64=y
BR2_TOOLCHAIN_EXTERNAL=y
BR2_TOOLCHAIN_EXTERNAL_BOOTLIN_X86_64_UCLIBC_STABLE=y
BR2_DL_DIR="${BR2_EXTERNAL_CURIOS_PATH}/dl"
BR2_CCACHE=y
BR2_CCACHE_DIR="${BR2_EXTERNAL_CURIOS_PATH}/.ccache"
BR2_GLOBAL_PATCH_DIR="${BR2_EXTERNAL_CURIOS_PATH}/patches"
BR2_TARGET_GENERIC_HOSTNAME="curiOS"
BR2_TARGET_GENERIC_ISSUE="Welcome to curiOS"
# BR2_TARGET_GENERIC_GETTY is not set
# BR2_TARGET_GENERIC_REMOUNT_ROOTFS_RW is not set
BR2_ROOTFS_OVERLAY="$(BR2_EXTERNAL_CURIOS_PATH)/board/common/rootfs $(BR2_EXTERNAL_CURIOS_PATH)/board/system/rootfs $(BR2_EXTERNAL_CURIOS_PATH)/board/nftables/rootfs"
BR2_ROOTFS_POST_BUILD_SCRIPT="$(BR2_EXTERNAL_CURIOS_PATH)/board/common/post-build.sh"
BR2_PACKAGE_BUSYBOX_CONFIG="$(BR2_EXTERNAL_CURIOS_PATH)/board/system/busybox_defconfig"
BR2_PACKAGE_BUSYBOX_SHOW_OTHERS=y
BR2_PACKAGE_LIBCURL=y
BR2_PACKAGE_NETOPEER2=y
BR2_PACKAGE_NETOPEER2_CLI=y
BR2_PACKAGE_DNSMASQ=y
BR2_PACKAGE_DROPBEAR=y
BR2_PACKAGE_DROPBEAR_DISABLE_REVERSEDNS=y
BR2_PACKAGE_MINI_SNMPD=y
BR2_PACKAGE_NFTABLES=y
BR2_PACKAGE_NTP=y
BR2_PACKAGE_NTP_NTP_KEYGEN=y
BR2_PACKAGE_NTP_NTP_SHM_CLK=y
BR2_PACKAGE_NTP_NTPD_ATOM_PPS=y
BR2_PACKAGE_NTP_NTPDATE=y
BR2_PACKAGE_NTP_NTPDC=y
BR2_PACKAGE_NTP_NTPQ=y
BR2_PACKAGE_NTP_NTPTIME=y
BR2_PACKAGE_NTP_TICKADJ=y
BR2_PACKAGE_TCPDUMP=y
BR2_PACKAGE_SYSKLOGD=y
BR2_PACKAGE_SYSKLOGD_LOGGER=y
BR2_PACKAGE_MG=y
BR2_TARGET_ROOTFS_OCI=y
BR2_TARGET_ROOTFS_OCI_AUTHOR="curiOS"
BR2_TARGET_ROOTFS_OCI_TAG="edge"
BR2_TARGET_ROOTFS_OCI_ENTRYPOINT="/sbin/init"
BR2_TARGET_ROOTFS_OCI_PORTS="22/tcp 161/tcp 161/udp"
BR2_TARGET_ROOTFS_OCI_LABELS=".url=https://github.com/kernelkit/curiOS .title=curiOS"
# BR2_TARGET_ROOTFS_TAR is not set
BR2_PACKAGE_MCJOIN=y
BR2_PACKAGE_MPING=y
```

## package/mcjoin/Config.in
```kconfig
config BR2_PACKAGE_MCJOIN
	bool "mcjoin"
	help
	  Simple and easy-to-use tool to test IP multicast, featuring:

	    * a multicast generator (server)
	    * a multicast data sink (client)
	    * supports joining/sending to one or more groups:
	      * ASM (*,G)
	      * SSM (S,G)
	    * supports both IPv4 and IPv6

	  http://github.com/troglobit/mcjoin
```

## package/mping/Config.in
```kconfig
config BR2_PACKAGE_MPING
        bool "mping"
        help
           A simple multicast ping program.  Can act as both sender and
           receiver/reflector of UDP multicast, IPv4 and IPv6 supported.

           http://github.com/troglobit/mping
```

## package/nft-helper/Config.in
```kconfig
config BR2_PACKAGE_NFT_HELPER
	bool "nft-helper"
	help
	  Wrapper for nft running under tini.  At startup it takes
	  its first command line argument as the nftables.conf to
	  load with: 'nft -f /path/to/nftables.conf' on any signal
	  it shuts down by calling 'nft flush ruleset'.
```

## package/openresty/Config.in
```kconfig
config BR2_PACKAGE_OPENRESTY
	bool "openresty"
	depends on !BR2_PACKAGE_NGINX
	select BR2_PACKAGE_PCRE
	select BR2_PACKAGE_PCRE_UTF
	select BR2_PACKAGE_OPENSSL
	help
	  OpenResty NGINX Variant

	  http://github.com/openresty/openresty
```
